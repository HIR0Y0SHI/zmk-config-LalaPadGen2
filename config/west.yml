## config/west.yml
```yaml
manifest:
  remotes:
    - name: zmkfirmware
      url-base: https://github.com/zmkfirmware
    - name: ShiniNet
      url-base: https://github.com/ShiniNet/
    - name: caksoylar
      url-base: https://github.com/caksoylar
    - name: HIR0Y0SHI
      url-base: https://github.com/HIR0Y0SHI
  projects:
    - name: zmk
      remote: zmkfirmware
      revision: v0.3.0
      import: app/west.yml
    - name: zmk-driver-iqs9151
      remote: HIR0Y0SHI
      revision: main
    - name: zmk-easy-charge-indicator
      remote: ShiniNet
      revision: main
    - name: zmk-rgbled-widget
      remote: caksoylar
      revision: v0.3
  self:
    path: config
```
